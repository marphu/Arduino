// Объявление переменных:
// для типа действия
// 10 байт - с запасом (на самом деле нужно только 2)
char action[10];
// Номер реле строкой - с запасом
char num[10];
// Номер реле числом
int rele;
// Массив пинов отключения
//int pino[] = { 22, 24, 26, 28, 30, 32, 35};
int pino[] = { 11,  9,  7,  5,  3};
// Массив пинов включения
//int pinc[] = { 23, 25, 27, 29, 31, 34, 36};
int pinc[] = { 10,  8,  6,  4,  2};
int n = 5;
// Строка состояний реле. При каждом изменении
// меняется соответствующая позиция в строке и
// выводиться на ком порт
char state[8] = "iiiiiii";
// Размер буффера
int BSize = 30;
// Задержка для реле, мс
int RDelay = 200;

// Инициализация оборудования
void setup() {
  // Инициализация ком-порта со скоростью 9600 бод
  Serial.begin(9600);
  // переборр элементов массива пинов включения/отключения
  for ( int i = 0; i < n ; i++ ) {
    // Пины включения отключения конфигурируются на выход
    pinMode(pino[i], OUTPUT);
    pinMode(pinc[i], OUTPUT);
    // На пинах задается логический ноль
    digitalWrite(pino[rele], LOW);
    digitalWrite(pinc[rele], LOW);
  }
/*  for ( int i = 0; i < 5 ; i++ ) {
    // на пине замыкания - логическая 1
    digitalWrite(pinc[rele], HIGH);
    // Изменение строки состояний
    state[i] = 'C';
  }
  // Задержка. По идее можно меньше,
  delay(RDelay * 2.5);*/
  for ( int i = 0; i < n ; i++ ) {
    // но не всегда срабатывает реле
    // На пине замыкания логический ноль
    digitalWrite(pinc[rele], HIGH);
  }
  // Задержка
  delay(RDelay * 2.5 * 2);
  for ( int i = 0; i < n ; i++ ) {
    // но не всегда срабатывает реле
    // На пине замыкания логический ноль
    digitalWrite(pinc[rele], LOW);
  }
  // Задержка
  delay(RDelay * 2.5 * 2);
  for ( int i = 0; i < n ; i++ ) {
    // На пине Размыкания логическая 1
    digitalWrite(pino[rele], HIGH);
    // Изменение строки состояния
    state[i] = 'O';
    delay(RDelay/5);
  }
  // Задержка
  delay(RDelay * 2);
  for ( int i = 0; i < n ; i++ ) {
    // Логический ноль на пине размыкания
    digitalWrite(pino[rele], LOW);
  }
  // задержка
  //delay(RDelay * 2.5);
  // вывод строки состояния
  Serial.println(state);
}

void loop() {
  // Инициализация переменной для длинны переданных данных
  int i = 0;
  // Инициализация буффера для приема данных. Именно тут,
  // что бы в буфере не оставалось ничего лишнего
  char buffer[BSize];
  // Вслучае если в ком порте есть какие-то данные
  if (Serial.available()) {
    // ЗадержкаЮ для получения всех данных
    delay(100);
    // Пока есть данные и пока емть место в буфере
    while ( Serial.available() && i < BSize - 1) {
      // Читать данные из ком-порта в буфер
      buffer[i++] = Serial.read();
    }
    // Добавление в конец прочтенных данных нулевого символа
    // для коректной обработки строки
    buffer[i++] = '\0';
  }
  // По умолчанию номер реле -1
  rele = -1;
  // если какие-то данные получены -
  if (i > 0) {
    // То раскидать полученые данные в переменные action
    // и num
    sscanf(buffer, "%[^,],%[^,],%f", &action, &num);
    // Так же получить численое выражение номера реле
    // минус один, для получения элемента массива
    rele = atoi(num) - 1;
    // Если все это выходит за пределы наших пинов
    // (5-1)
    if (rele > (n-1) ) {
      // То переменная приходит в начальное состояние
      rele = -1;
    }
  }
  // Если номер реле неотрицателен
  if ( rele >= 0 ) {
    // если первый символ типа действий "С"
    if (action[0] == 'c' ) {
      // На пине отключения 0
      digitalWrite(pino[rele], LOW);
      // На пине включения 1
      digitalWrite(pinc[rele], HIGH);
      // Изменение строки состояния
      state[rele] = 'c';
      // Задержка
      delay(RDelay);
      // На пине включения 0
      digitalWrite(pinc[rele], LOW);
      // если первый символ типа действий "о"
    } else if (action[0] == 'o' ) {
      // На пине включения 0
      digitalWrite(pinc[rele], LOW);
      // На пине отключения 1
      digitalWrite(pino[rele], HIGH);
      // Изменение строки состояния
      state[rele] = 'o';
      // Задержка
      delay(RDelay);
      // На пине отключения 0
      digitalWrite(pino[rele], LOW);
    }
    // Вывод строки состояния
    Serial.println(state);
  }
}
